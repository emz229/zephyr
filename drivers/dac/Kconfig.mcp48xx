## drivers/dac/Kconfig.mcp48xx
```kconfig
# Copyright 2024 Novatech LLC
#
# SPDX-License-Identifier: Apache-2.0

config DAC_MCP48XX
	bool "Microchip MCP48XX DAC driver"
	select SPI
	help
	  Enable driver for the Microchip MCP48xx series DAC devices.
```
